## petalinux/cora-z7-10/project-spec/configs/configs/Kconfig
```kconfig
mainmenu "PetaLinux System Configuration"
config SUBSYSTEM_TYPE_LINUX
        bool
        default y
        select SYSTEM_ZYNQ

config SYSTEM_ZYNQ
        bool "ZYNQ Configuration"
        help
          ZYNQ Configuration for the project.
          All these config options will be in /home/eldden28/code/test-project/petalinux/cora-z7-10/project-spec/configs/config

config SUBSYSTEM_DISTRO_PETALINUX
        bool
        default y
        help

source /home/eldden28/code/test-project/petalinux/cora-z7-10/project-spec/configs/configs/Kconfig.main
```

## software/edf/meta-sonar/conf/machine/ultrazed-3eg-iocc-edf.conf
```bitbake
# Production UltraZed-EG 3EG SOM on the Avnet AES-ZU-IOCC-G carrier.
require conf/machine/zynqmp-ultrazed-3eg-iocc-sdt-full.conf
MACHINEOVERRIDES:append = ":ultrazed-3eg-iocc"
hostname:pn-base-files = "ultrazed-3eg-iocc"

SERIAL_CONSOLES = "115200;ttyPS0"
KERNEL_COMMAND_APPEND = "console=ttyPS0,115200 earlycon net.ifnames=0"
UBOOT_BOOT_SCRIPT:ultrazed-3eg-iocc = "u-boot-xlnx-scr"
BOOTMODE = "ultrazed-iocc"
WKS_FILES = "sonar-sd.wks"
IMAGE_FSTYPES = "tar.gz ext4 wic wic.gz wic.bmap"
IMAGE_BOOT_FILES = "boot.bin;BOOT.BIN boot.scr Image system.dtb"
WKS_FILE_DEPENDS:append = " virtual/boot-bin"

EXTRA_DT_INCLUDE_FILES:append = " ultrazed-iocc-board.dtsi"
FILESEXTRAPATHS:prepend:pn-device-tree := "${SONAR_EDF_LAYERDIR}/recipes-bsp/device-tree/files:"
```

## software/petalinux/cora-z7-10-baseline/project-spec/configs/configs/Kconfig
```kconfig
mainmenu "PetaLinux System Configuration"
config SUBSYSTEM_TYPE_LINUX
        bool
        default y
        select SYSTEM_ZYNQ

config SYSTEM_ZYNQ
        bool "ZYNQ Configuration"
        help
          ZYNQ Configuration for the project.
          All these config options will be in /home/eldden28/code/test-project/software/petalinux/cora-z7-10-baseline/project-spec/configs/config

config SUBSYSTEM_DISTRO_PETALINUX
        bool
        default y
        help

source /home/eldden28/code/test-project/software/petalinux/cora-z7-10-baseline/project-spec/configs/configs/Kconfig.main
```

## software/petalinux/cora-z7-10-baseline/project-spec/configs/rootfsconfigs/Kconfig.user
```kconfig
menu "user packages " 
config cora-navigation
	 bool "cora-navigation"
	 help

config cora-sonar
	 bool "cora-sonar"
	 help

config gnuradio
	 bool "gnuradio"
	 help

config gpio-demo  
	 bool "gpio-demo"
	 help
	
config peekpoke  
	 bool "peekpoke"
	 help
	
endmenu
```
